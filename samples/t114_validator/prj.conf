## CMakeLists.txt
```
cmake_minimum_required(VERSION 3.20.0)
find_package(Zephyr REQUIRED HINTS $ENV{ZEPHYR_BASE})
project(t114_validator)

target_sources(app PRIVATE
    src/main.c
    src/button.c
    src/test.c
    src/ui.c
)
```

## prj.conf
```kconfig
CONFIG_MAIN_STACK_SIZE=8192
CONFIG_LV_Z_MEM_POOL_SIZE=32768

CONFIG_DISPLAY=y
CONFIG_DISPLAY_LOG_LEVEL_ERR=y

CONFIG_INPUT=y
CONFIG_GPIO=y
CONFIG_LED=y
CONFIG_LED_GPIO=y
CONFIG_LED_STRIP=y

CONFIG_ADC=y
CONFIG_SENSOR=y

CONFIG_BT=y
CONFIG_BT_PERIPHERAL=n
CONFIG_BT_CENTRAL=n

CONFIG_LORA=y

CONFIG_FLASH=y
CONFIG_NORDIC_QSPI_NOR=y

CONFIG_USB_DEVICE_STACK_NEXT=y
CONFIG_USB_CDC_ACM=y

CONFIG_LOG=y
CONFIG_CONSOLE=y
CONFIG_UART_CONSOLE=y

CONFIG_REGULATOR=y

CONFIG_LVGL=y
CONFIG_LV_USE_LABEL=y
CONFIG_LV_USE_BAR=y
CONFIG_LV_FONT_MONTSERRAT_14=y
CONFIG_LV_FONT_MONTSERRAT_16=y
CONFIG_LV_FONT_MONTSERRAT_24=y
CONFIG_LV_FONT_UNSCII_8=y
CONFIG_LV_FONT_UNSCII_16=y
```

## boards/heltec_mesh_node_t114_nrf52840_uf2.overlay
```dts
/**
 * Copyright (c) 2026 Yeray Lois Sanchez
 *
 * SPDX-License-Identifier: Apache-2.0
 */

&{/vext} {
	status = "okay";
	regulator-boot-on;
};
```

## src/main.c
```c
/*
 * Copyright (c) 2026 Yeray Lois Sanchez
 *
 * SPDX-License-Identifier: Apache-2.0
 */

#include "button.h"
#include "test.h"
#include "ui.h"
#include <zephyr/device.h>
#include <zephyr/devicetree.h>
#include <zephyr/drivers/display.h>
#include <zephyr/drivers/usb/udc.h>
#include <zephyr/kernel.h>
#include <lvgl.h>

#define AUTO_STEP_COUNT 9

enum app_state {
	STATE_DASHBOARD,
	STATE_AUTO_TEST,
	STATE_MANUAL_MENU,
	STATE_TEST_PREVIEW,
	STATE_MANUAL_RUN,
	STATE_RESULT,
};

struct auto_step {
	const char *name;
	void (*run)(void *res);
	size_t res_size;
};

static enum app_state state = STATE_DASHBOARD;
static int dashboard_sel = 0;
static int auto_step = 0;
static int manual_sel = 0;
static bool auto_waiting = false;
static bool auto_test_waiting_button = false;
static int auto_advance_counter = 0;
static int bat_mv = 0;
static int temp_c = 0;

static struct { enum test_result status; } r_button;
static struct test_led_result r_led;
static struct test_neopixel_result r_np;
static struct test_adc_result r_adc;
static struct test_temp_result r_temp;
static struct test_ble_result r_ble;
static struct test_lora_result r_lora;
static struct test_qspi_result r_qspi;

static const char *instructions[AUTO_STEP_COUNT] = {
	"Press User Button",
	"Check LED is visible",
	"Check RGB glow",
	"Check display colors",
	"Check voltage reading",
	"Check temp reading",
	"Enable BT on host",
	"Check antenna connected",
	"Check flash access",
};

static const struct auto_step steps[AUTO_STEP_COUNT] = {
	{ "Button", NULL, 0 },
	{ "LED", (void (*)(void *))test_led_run, sizeof(r_led) },
	{ "NeoPixel", (void (*)(void *))test_neopixel_run, sizeof(r_np) },
	{ "TFT", (void (*)(void *))test_tft_run, 0 },
	{ "ADC Battery", (void (*)(void *))test_adc_run, sizeof(r_adc) },
	{ "Temperature", (void (*)(void *))test_temp_run, sizeof(r_temp) },
	{ "BLE Radio", (void (*)(void *))test_ble_run, sizeof(r_ble) },
	{ "LoRa TX", (void (*)(void *))test_lora_run, sizeof(r_lora) },
	{ "QSPI Flash", (void (*)(void *))test_qspi_run, sizeof(r_qspi) },
};

static bool usb_is_connected(void)
{
	const struct device *udc_dev = DEVICE_DT_GET(DT_NODELABEL(usbd));

	if (!device_is_ready(udc_dev)) {
		return false;
	}
	return udc_is_enabled(udc_dev);
}

static void update_dashboard_values(void)
{
	struct test_adc_result adc_res = {0};

	test_adc_run(&adc_res);
	if (adc_res.status == TEST_PASS) {
		bat_mv = adc_res.voltage_mv;
	}

	temp_c = read_temp_simple();

	ui_update_bat_temp(bat_mv, temp_c, usb_is_connected());
}

static int auto_test_timer_cs = 0;

static void run_auto_step(void)
{
	if (auto_step >= AUTO_STEP_COUNT) {
		bool all_pass = true;
		if (r_button.status != TEST_PASS) all_pass = false;
		if (r_led.status != TEST_PASS) all_pass = false;
		if (r_np.status != TEST_PASS) all_pass = false;
		if (r_adc.status != TEST_PASS) all_pass = false;
		if (r_temp.status != TEST_PASS) all_pass = false;
		if (r_ble.status != TEST_PASS) all_pass = false;
		if (r_lora.status != TEST_PASS) all_pass = false;
		if (r_qspi.status != TEST_PASS && r_qspi.status != TEST_SKIP) all_pass = false;

		enum test_result results[AUTO_STEP_COUNT] = {
			r_button.status, r_led.status, r_np.status,
			TEST_PASS, r_adc.status, r_temp.status,
			r_ble.status, r_lora.status, r_qspi.status
		};
		ui_show_result(all_pass, results, AUTO_STEP_COUNT);
		state = STATE_RESULT;
		return;
	}

	const struct auto_step *s = &steps[auto_step];

	/* Button test: wait for actual button press */
	if (auto_step == 0) {
		ui_show_auto_test(0, AUTO_STEP_COUNT, "Button", TEST_RUNNING,
				  instructions[0]);
		auto_test_waiting_button = true;
		auto_waiting = true;
		auto_advance_counter = 0;
		return;
	}

	/* Normal test: run and auto-advance after delay */
	ui_show_auto_test(auto_step, AUTO_STEP_COUNT, s->name, TEST_RUNNING,
			  instructions[auto_step]);
	lv_timer_handler();
	display_blanking_off(DEVICE_DT_GET(DT_CHOSEN(zephyr_display)));

	void *res = NULL;
	if (s->res_size > 0) {
		switch (auto_step) {
		case 1: res = &r_led; break;
		case 2: res = &r_np; break;
		case 4: res = &r_adc; break;
		case 5: res = &r_temp; break;
		case 6: res = &r_ble; break;
		case 7: res = &r_lora; break;
		case 8: res = &r_qspi; break;
		}
		s->run(res);
	} else {
		test_tft_run();
	}

	ui_show_auto_test(auto_step, AUTO_STEP_COUNT, s->name,
			  (s->res_size > 0) ? ((struct test_led_result *)res)->status : TEST_PASS,
			  instructions[auto_step]);
	auto_waiting = true;
	auto_advance_counter = 0;
}

static enum test_result manual_run_selected(void)
{
	enum test_result result = TEST_SKIP;

	switch (manual_sel) {
	case 0:
		test_led_run(&r_led);
		result = r_led.status;
		break;
	case 1:
		test_neopixel_run(&r_np);
		result = r_np.status;
		break;
	case 2:
		test_tft_run();
		result = TEST_PASS;
		break;
	case 3:
		test_adc_run(&r_adc);
		if (r_adc.status == TEST_PASS) bat_mv = r_adc.voltage_mv;
		result = r_adc.status;
		break;
	case 4:
		test_temp_run(&r_temp);
		if (r_temp.status == TEST_PASS) temp_c = r_temp.temp_c;
		result = r_temp.status;
		break;
	case 5:
		test_ble_run(&r_ble);
		result = r_ble.status;
		break;
	case 6:
		test_lora_run(&r_lora);
		result = r_lora.status;
		break;
	case 7:
		test_qspi_run(&r_qspi);
		result = r_qspi.status;
		break;
	}

	ui_show_manual_result(result);
	lv_timer_handler();
	display_blanking_off(DEVICE_DT_GET(DT_CHOSEN(zephyr_display)));
	return result;
}

int main(void)
{
	const struct device *display_dev = DEVICE_DT_GET(DT_CHOSEN(zephyr_display));

	button_init();
	ui_init();

	ui_show_dashboard(bat_mv, temp_c, dashboard_sel, usb_is_connected());

	lv_timer_handler();
	display_blanking_off(display_dev);

	update_dashboard_values();

	while (1) {
		button_poll();
		enum button_event evt = button_get_event();

		switch (state) {
		case STATE_DASHBOARD:
			if (evt == BTN_EVT_SHORT) {
				dashboard_sel = !dashboard_sel;
				ui_show_dashboard(bat_mv, temp_c, dashboard_sel, usb_is_connected());
			} else if (evt == BTN_EVT_LONG) {
				if (dashboard_sel == 0) {
					state = STATE_AUTO_TEST;
					auto_step = 0;
					auto_waiting = false;
					auto_test_waiting_button = false;
					auto_advance_counter = 0;
					auto_test_timer_cs = 0;
					r_button.status = TEST_PENDING;
					run_auto_step();
				} else {
					state = STATE_MANUAL_MENU;
					manual_sel = 0;
					ui_show_manual_menu(manual_sel, 9);
				}
			}
			break;

		case STATE_AUTO_TEST:
			if (auto_waiting) {
				/* Update chronometer every 100ms */
				static int tick;
				tick++;
				if (tick % 5 == 0) {
					auto_test_timer_cs++;
					ui_update_timer(auto_test_timer_cs);
				}

				if (auto_test_waiting_button) {
					/* Button test: 500ms grace then accept any press */
					auto_advance_counter++;
					if (auto_advance_counter >= 25) {
						if (evt != BTN_EVT_NONE) {
							r_button.status = TEST_PASS;
							auto_test_waiting_button = false;
							auto_waiting = false;
							auto_advance_counter = 0;
							auto_step++;
							run_auto_step();
						}
					}
				} else {
					/* Auto-advance after 800ms */
					auto_advance_counter++;
					if (auto_advance_counter >= 40) {
						auto_advance_counter = 0;
						auto_waiting = false;
						auto_step++;
							run_auto_step();
					}
				}
			}
			break;

		case STATE_MANUAL_MENU:
			if (evt == BTN_EVT_SHORT) {
				manual_sel = (manual_sel + 1) % 9;
				ui_show_manual_menu(manual_sel, 9);
			} else if (evt == BTN_EVT_LONG) {
				if (manual_sel == 8) {
					/* Back to main */
					state = STATE_DASHBOARD;
					ui_show_dashboard(bat_mv, temp_c, dashboard_sel, usb_is_connected());
			} else {
				/* Show preview */
				state = STATE_TEST_PREVIEW;
				const char *instr = instructions[manual_sel + 1];
				const char *names[] = {
					"LED", "NeoPixel", "TFT", "ADC",
					"Temp", "BLE", "LoRa", "QSPI"
				};
				ui_show_test_preview(names[manual_sel], instr);
			}
			}
			break;

		case STATE_TEST_PREVIEW:
			if (evt == BTN_EVT_SHORT) {
				/* Cancel */
				state = STATE_MANUAL_MENU;
				ui_show_manual_menu(manual_sel, 9);
			} else if (evt == BTN_EVT_LONG) {
				/* Run test */
				state = STATE_MANUAL_RUN;
				manual_run_selected();
			}
			break;

		case STATE_MANUAL_RUN:
			/* Show result for 2s then back to menu */
			{
				static int run_tick = 0;
				run_tick++;
				if (run_tick >= 100) { /* 100 * 20ms = 2000ms */
					run_tick = 0;
					state = STATE_MANUAL_MENU;
					ui_show_manual_menu(manual_sel, 9);
				}
			}
			break;

		case STATE_RESULT:
			if (evt != BTN_EVT_NONE) {
				state = STATE_DASHBOARD;
				ui_show_dashboard(bat_mv, temp_c, dashboard_sel, usb_is_connected());
			}
			break;
		}

		if (state == STATE_DASHBOARD) {
			static int tick;
			tick++;
			if (tick % 20 == 0) {
				update_dashboard_values();
			}
		}

		lv_timer_handler();
		k_sleep(K_MSEC(20));
	}

	return 0;
}
```

## src/button.c
```c
/*
 * Copyright (c) 2026 Yeray Lois Sanchez
 *
 * SPDX-License-Identifier: Apache-2.0
 */

#include "button.h"
#include <zephyr/input/input.h>
#include <zephyr/kernel.h>

#define LONG_PRESS_MS 800

static volatile enum button_event pending_evt = BTN_EVT_NONE;
static struct k_work_delayable long_press_work;
static volatile bool long_fired;

static void long_press_handler(struct k_work *work)
{
	ARG_UNUSED(work);
	long_fired = true;
	pending_evt = BTN_EVT_LONG;
}

static void button_input_cb(struct input_event *evt, void *user_data)
{
	ARG_UNUSED(user_data);

	if (evt->sync == 0) {
		return;
	}

	if (evt->value) {
		long_fired = false;
		k_work_reschedule(&long_press_work, K_MSEC(LONG_PRESS_MS));
	} else {
		if (!long_fired) {
			k_work_cancel_delayable(&long_press_work);
			pending_evt = BTN_EVT_SHORT;
		}
	}
}

INPUT_CALLBACK_DEFINE(NULL, button_input_cb, NULL);

void button_init(void)
{
	k_work_init_delayable(&long_press_work, long_press_handler);
	long_fired = false;
	pending_evt = BTN_EVT_NONE;
}

enum button_event button_get_event(void)
{
	enum button_event evt = pending_evt;

	pending_evt = BTN_EVT_NONE;
	return evt;
}

void button_poll(void)
{
}
```

## src/button.h
```c
/*
 * Copyright (c) 2026 Yeray Lois Sanchez
 *
 * SPDX-License-Identifier: Apache-2.0
 */

#include <stdbool.h>
#include <stdint.h>

enum button_event {
    BTN_EVT_NONE,
    BTN_EVT_SHORT,
    BTN_EVT_LONG,
};

void button_init(void);
void button_poll(void);
enum button_event button_get_event(void);
```

## src/test.c
```c
/*
 * Copyright (c) 2026 Yeray Lois Sanchez
 *
 * SPDX-License-Identifier: Apache-2.0
 */

#include "test.h"
#include "ui.h"
#include <zephyr/device.h>
#include <zephyr/devicetree.h>
#include <zephyr/drivers/adc.h>
#include <zephyr/drivers/display.h>
#include <zephyr/drivers/gpio.h>
#include <zephyr/drivers/led_strip.h>
#include <zephyr/drivers/sensor.h>
#include <zephyr/drivers/spi.h>
#include <zephyr/kernel.h>
#include <zephyr/logging/log.h>
#include <zephyr/bluetooth/bluetooth.h>
#include <zephyr/drivers/lora.h>
#include <zephyr/dt-bindings/adc/nrf-saadc.h>
#include <lvgl.h>

LOG_MODULE_REGISTER(test);

#define LED0_NODE DT_ALIAS(led0)
#define STRIP_NODE DT_ALIAS(led_strip)
#define ADC_NODE DT_NODELABEL(adc)
#define TEMP_NODE DT_NODELABEL(temp)
#define LORA_NODE DT_ALIAS(lora0)

static const struct gpio_dt_spec led = GPIO_DT_SPEC_GET(LED0_NODE, gpios);
static const struct device *strip_dev;
static const struct adc_channel_cfg adc_cfg = {
	.channel_id = 2,
	.gain = ADC_GAIN_1_6,
	.reference = ADC_REF_INTERNAL,
	.acquisition_time = ADC_ACQ_TIME_DEFAULT,
	.input_positive = NRF_SAADC_AIN2,
};

void test_led_run(struct test_led_result *res)
{
	res->status = TEST_RUNNING;

	if (!device_is_ready(led.port)) {
		res->status = TEST_FAIL;
		return;
	}

	gpio_pin_configure_dt(&led, GPIO_OUTPUT_ACTIVE);

	for (int i = 0; i < 3; i++) {
		gpio_pin_set_dt(&led, 1);
		k_sleep(K_MSEC(200));
		gpio_pin_set_dt(&led, 0);
		k_sleep(K_MSEC(200));
	}

	res->status = TEST_PASS;
}

void test_button_run(struct test_button_result *res)
{
	res->status = TEST_PENDING;
}

void test_neopixel_run(struct test_neopixel_result *res)
{
	res->status = TEST_RUNNING;

	strip_dev = DEVICE_DT_GET(STRIP_NODE);
	if (!device_is_ready(strip_dev)) {
		res->status = TEST_FAIL;
		return;
	}

	struct led_rgb colors[] = {
		{ .r = 50, .g = 0, .b = 0 },   /* red dim */
		{ .r = 0, .g = 50, .b = 0 },   /* green dim */
		{ .r = 0, .g = 0, .b = 50 },   /* blue dim */
	};
	struct led_rgb off = { 0 };

	for (int c = 0; c < 3; c++) {
		/* Light both pixels with the same color */
		struct led_rgb px[2] = { colors[c], colors[c] };
		int err = led_strip_update_rgb(strip_dev, px, 2);
		if (err) {
			LOG_ERR("led_strip_update_rgb failed: %d", err);
			res->status = TEST_FAIL;
			return;
		}
		k_sleep(K_MSEC(500));
	}

	struct led_rgb px_off[2] = { off, off };
	int err = led_strip_update_rgb(strip_dev, px_off, 2);
	if (err) {
		LOG_ERR("led_strip_update_rgb (off) failed: %d", err);
		res->status = TEST_FAIL;
		return;
	}

	res->status = TEST_PASS;
}

void test_tft_run(void)
{
	const struct device *display_dev = DEVICE_DT_GET(DT_CHOSEN(zephyr_display));

	ui_show_tft_test();
	lv_timer_handler();
	display_blanking_off(display_dev);

	/* Show test pattern for 2s */
	k_sleep(K_MSEC(2000));
}

void test_adc_run(struct test_adc_result *res)
{
	res->status = TEST_RUNNING;

	const struct device *adc_dev = DEVICE_DT_GET(ADC_NODE);
	if (!device_is_ready(adc_dev)) {
		res->status = TEST_FAIL;
		return;
	}

	int err = adc_channel_setup(adc_dev, &adc_cfg);
	if (err) {
		res->status = TEST_FAIL;
		return;
	}

	int16_t buf;
	struct adc_sequence seq = {
		.buffer = &buf,
		.buffer_size = sizeof(buf),
		.channels = BIT(2),
		.resolution = 12,
	};

	err = adc_read(adc_dev, &seq);
	if (err) {
		res->status = TEST_FAIL;
		return;
	}

	int32_t raw = buf;
	if (raw < 0) {
		raw = 0;
	}

	int32_t vref = adc_ref_internal(adc_dev);
	int32_t mv = (raw * vref) / 4096;
	mv = (mv * 490) / 100;

	res->voltage_mv = mv;
	res->status = TEST_PASS;
}

int read_temp_simple(void)
{
	const struct device *temp_dev = DEVICE_DT_GET(TEMP_NODE);

	if (!device_is_ready(temp_dev)) {
		return 0;
	}

	int err = sensor_sample_fetch(temp_dev);
	if (err) {
		return 0;
	}

	struct sensor_value val;
	err = sensor_channel_get(temp_dev, SENSOR_CHAN_DIE_TEMP, &val);
	if (err) {
		return 0;
	}

	return val.val1;
}

void test_temp_run(struct test_temp_result *res)
{
	res->status = TEST_RUNNING;

	const struct device *temp_dev = DEVICE_DT_GET(TEMP_NODE);
	const struct device *display_dev = DEVICE_DT_GET(DT_CHOSEN(zephyr_display));

	if (!device_is_ready(temp_dev)) {
		res->status = TEST_FAIL;
		return;
	}

	/* Show temperature screen and take live readings for 3 seconds */
	ui_show_temp_test(0);
	lv_timer_handler();
	display_blanking_off(display_dev);

	int total_temp = 0;
	int samples = 0;

	for (int i = 0; i < 6; i++) {
		int err = sensor_sample_fetch(temp_dev);
		if (err) {
			continue;
		}

		struct sensor_value val;
		err = sensor_channel_get(temp_dev, SENSOR_CHAN_DIE_TEMP, &val);
		if (err) {
			continue;
		}

		total_temp += val.val1;
		samples++;

		ui_update_temp_test(val.val1);
		lv_timer_handler();
		display_blanking_off(display_dev);

		k_sleep(K_MSEC(500));
	}

	if (samples == 0) {
		res->status = TEST_FAIL;
		return;
	}

	res->temp_c = total_temp / samples;
	res->status = TEST_PASS;
}

void test_ble_run(struct test_ble_result *res)
{
	res->status = TEST_RUNNING;

#ifdef CONFIG_BT
	int err = bt_enable(NULL);
	if (err && err != -EALREADY) {
		res->status = TEST_FAIL;
		return;
	}

	res->status = TEST_PASS;
#else
	res->status = TEST_SKIP;
#endif
}

void test_lora_run(struct test_lora_result *res)
{
	res->status = TEST_RUNNING;

	const struct device *lora_dev = DEVICE_DT_GET(LORA_NODE);
	if (!device_is_ready(lora_dev)) {
		res->status = TEST_FAIL;
		return;
	}

	struct lora_modem_config cfg = {
		.frequency = 868000000,
		.bandwidth = BW_125_KHZ,
		.datarate = SF_7,
		.coding_rate = CR_4_5,
		.preamble_len = 8,
		.tx_power = 14,
		.tx = true,
	};

	int err = lora_config(lora_dev, &cfg);
	if (err) {
		res->status = TEST_FAIL;
		return;
	}

	uint8_t data[] = "T114_TEST";
	err = lora_send(lora_dev, data, sizeof(data));
	if (err) {
		res->status = TEST_FAIL;
		return;
	}

	res->status = TEST_PASS;
}

void test_qspi_run(struct test_qspi_result *res)
{
	res->status = TEST_RUNNING;

#if DT_NODE_HAS_STATUS(DT_NODELABEL(mx25r1635f), okay)
	const struct device *flash_dev = DEVICE_DT_GET(DT_NODELABEL(mx25r1635f));
	if (!device_is_ready(flash_dev)) {
		res->status = TEST_SKIP;
		return;
	}
	res->status = TEST_PASS;
#else
	res->status = TEST_SKIP;
#endif
}
```

## src/test.h
```c
/*
 * Copyright (c) 2026 Yeray Lois Sanchez
 *
 * SPDX-License-Identifier: Apache-2.0
 */

#ifndef TEST_H
#define TEST_H

#include <stdbool.h>
#include <stdint.h>

enum test_result {
    TEST_PENDING,
    TEST_RUNNING,
    TEST_PASS,
    TEST_FAIL,
    TEST_SKIP,
};

struct test_led_result {
    enum test_result status;
};

struct test_button_result {
    enum test_result status;
};

struct test_neopixel_result {
    enum test_result status;
};

struct test_tft_result {
    enum test_result status;
};

struct test_adc_result {
    enum test_result status;
    int voltage_mv;
};

struct test_temp_result {
    enum test_result status;
    int temp_c;
};

struct test_ble_result {
    enum test_result status;
};

struct test_lora_result {
    enum test_result status;
};

struct test_qspi_result {
    enum test_result status;
    uint32_t jedec_id;
};

void test_led_run(struct test_led_result *res);
void test_button_run(struct test_button_result *res);
void test_neopixel_run(struct test_neopixel_result *res);
void test_tft_run(void);
void test_adc_run(struct test_adc_result *res);
int read_temp_simple(void);
void test_temp_run(struct test_temp_result *res);
void test_ble_run(struct test_ble_result *res);
void test_lora_run(struct test_lora_result *res);
void test_qspi_run(struct test_qspi_result *res);

#endif
```
