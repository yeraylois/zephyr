## CMakeLists.txt
```
cmake_minimum_required(VERSION 3.20.0)
find_package(Zephyr REQUIRED HINTS $ENV{ZEPHYR_BASE})
project(t114_validator_screenshots)

target_sources(app PRIVATE
    src/main.c
    src/ui.c
)
```

## prj.conf
```kconfig
CONFIG_MAIN_STACK_SIZE=8192
CONFIG_LV_Z_MEM_POOL_SIZE=32768

CONFIG_DISPLAY=y
CONFIG_SDL_DISPLAY=y

CONFIG_LVGL=y
CONFIG_LV_USE_LABEL=y
CONFIG_LV_USE_BAR=y
CONFIG_LV_FONT_MONTSERRAT_14=y
CONFIG_LV_FONT_MONTSERRAT_16=y
CONFIG_LV_FONT_UNSCII_8=y
CONFIG_LV_FONT_UNSCII_16=y

CONFIG_LOG=y
CONFIG_CONSOLE=y
CONFIG_UART_CONSOLE=y
```

## boards/native_sim.overlay
```dts
&sdl_dc {
	height = <135>;
	width = <240>;
};
```

## src/main.c
```c
/*
 * Copyright (c) 2026 Yeray Lois Sanchez
 *
 * SPDX-License-Identifier: Apache-2.0
 */

#include "ui.h"
#include <zephyr/device.h>
#include <zephyr/devicetree.h>
#include <zephyr/drivers/display.h>
#include <zephyr/kernel.h>
#include <lvgl.h>

#define SLEEP_S 4

int main(void)
{
	const struct device *display_dev =
		DEVICE_DT_GET(DT_CHOSEN(zephyr_display));

	if (!device_is_ready(display_dev)) {
		printk("Display not ready\n");
		return 0;
	}

	ui_init();

	/* 1. Dashboard */
	ui_show_dashboard(3850, 23, 0, true);
	lv_timer_handler();
	display_blanking_off(display_dev);
	k_sleep(K_SECONDS(SLEEP_S));

	/* 2. Auto test - Button step */
	ui_show_auto_test(0, 9, "Button", TEST_RUNNING,
			  "Press User Button");
	lv_timer_handler();
	k_sleep(K_SECONDS(SLEEP_S));

	/* 3. Auto test - NeoPixel step */
	ui_show_auto_test(2, 9, "NeoPixel", TEST_PASS,
			  "Check RGB glow");
	lv_timer_handler();
	k_sleep(K_SECONDS(SLEEP_S));

	/* 4. Manual menu */
	ui_show_manual_menu(2, 9);
	lv_timer_handler();
	k_sleep(K_SECONDS(SLEEP_S));

	/* 5. Test preview */
	ui_show_test_preview("TFT", "Check display colors");
	lv_timer_handler();
	k_sleep(K_SECONDS(SLEEP_S));

	/* 6. Result - all pass */
	{
		enum test_result results[9] = {
			TEST_PASS, TEST_PASS, TEST_PASS,
			TEST_PASS, TEST_PASS, TEST_PASS,
			TEST_PASS, TEST_PASS, TEST_SKIP
		};
		ui_show_result(true, results, 9);
		lv_timer_handler();
		k_sleep(K_SECONDS(SLEEP_S));
	}

	/* 7. TFT color test */
	ui_show_tft_test();
	lv_timer_handler();
	k_sleep(K_SECONDS(SLEEP_S));

	/* Keep window open */
	while (1) {
		lv_timer_handler();
		k_sleep(K_MSEC(20));
	}

	return 0;
}
```

## src/ui.h
```c
/*
 * Copyright (c) 2026 Yeray Lois Sanchez
 *
 * SPDX-License-Identifier: Apache-2.0
 */

#ifndef UI_H
#define UI_H

#include "test.h"
#include <lvgl.h>
#include <stdbool.h>

void ui_init(void);
void ui_show_dashboard(int bat_mv, int temp_c, int selected, bool usb_connected);
void ui_update_bat_temp(int bat_mv, int temp_c, bool usb_connected);

void ui_show_auto_test(int step, int total, const char *name,
                       enum test_result result, const char *instruction);
void ui_update_auto_test_progress(int step, int total);
void ui_update_timer(int total_cs);
void ui_set_instruction(const char *txt);

void ui_show_manual_menu(int selected, int total);
void ui_show_test_preview(const char *name, const char *instruction);
void ui_show_manual_result(enum test_result result);
void ui_show_result(bool all_pass, enum test_result *results, int count);

void ui_show_tft_test(void);

void ui_show_temp_test(int temp_c);
void ui_update_temp_test(int temp_c);

#endif
```
