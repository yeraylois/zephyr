## boards/heltec/heltec_mesh_node_t114/heltec_mesh_node_t114_nrf52840_defconfig
```kconfig
# Copyright (c) 2026 Yeray Lois Sanchez
# SPDX-License-Identifier: Apache-2.0

CONFIG_ARM_MPU=y
CONFIG_HW_STACK_PROTECTION=y
CONFIG_GPIO=y
CONFIG_REGULATOR=y
```
