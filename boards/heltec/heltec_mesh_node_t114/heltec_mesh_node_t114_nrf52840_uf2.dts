/*
 * Copyright (c) 2026 Yeray Lois Sanchez
 *
 * SPDX-License-Identifier: Apache-2.0
 */

/dts-v1/;
#include "heltec_mesh_node_t114_common.dtsi"
#include <nordic/nrf52840_partition_uf2_sdv6.dtsi>

/ {
	model = "Heltec Mesh Node T114";
	compatible = "heltec,mesh-node-t114-uf2";

	chosen {
		zephyr,sram = &sd_ram0;
	};

	reserved-memory {
		#address-cells = <1>;
		#size-cells = <1>;
		ranges;

		sd_ram0: memory@20006000 {
			compatible = "mmio-sram";
			reg = <0x20006000 0x3a000>;
		};
	};
};

#include <../boards/common/usb/cdc_acm_serial.dtsi>
